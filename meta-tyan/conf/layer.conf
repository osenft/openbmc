## meta-tyan/conf/layer.conf
```bitbake
# We have a conf and classes directory, add to BBPATH
BBPATH .= ":${LAYERDIR}"

# We have recipes-* directories, add to BBFILES
BBFILES += "${LAYERDIR}/meta-common/recipes-*/*/*.bb \
            ${LAYERDIR}/meta-common/recipes-*/*/*.bbappend"

BBFILE_COLLECTIONS += "tyan-layer"
BBFILE_PATTERN_tyan-layer = ""
LAYERVERSION_tyan-layer = "1"
LAYERSERIES_COMPAT_tyan-layer = "warrior zeus dunfell"

# Provide a variable that points the base of the tyan layer.
TYANBASE = '${@os.path.normpath("${LAYERDIR}/")}'
```

## meta-tyan/conf/machine/include/tyan.inc
```bitbake
OBMC_MACHINE_FEATURES += "\
        obmc-phosphor-fan-mgmt \
        obmc-phosphor-flash-mgmt \
        obmc-host-ipmi \
        obmc-host-state-mgmt \
        obmc-chassis-state-mgmt \
        obmc-bmc-state-mgmt \
        "

PREFERRED_PROVIDER_virtual/obmc-host-ipmi-hw = "phosphor-ipmi-kcs"
PREFERRED_PROVIDER_virtual/phosphor-ipmi-fru-inventory = "tyan-ipmi-fru-inventory-native"
PREFERRED_PROVIDER_virtual/phosphor-ipmi-fru-properties = "tyan-ipmi-fru-properties-native"
```

## meta-tyan/meta-s7106/conf/machine/s7106.conf
```bitbake
KMACHINE = "aspeed"
KERNEL_DEVICETREE = "${KMACHINE}-bmc-tyan-${MACHINE}.dtb"

UBOOT_MACHINE = "ast_g5_phy_config"

require conf/machine/include/ast2500.inc
require conf/machine/include/obmc-bsp-common.inc
require conf/machine/include/tyan.inc

FLASH_SIZE = "32768"

PREFERRED_PROVIDER_virtual/phosphor-ipmi-sensor-inventory = "s7106-ipmi-sensor-inventory-native"
PREFERRED_PROVIDER_virtual/obmc-fan-mgmt = "tyan-dummy"

VIRTUAL-RUNTIME_obmc-fan-presence = "tyan-dummy"

IMAGE_FEATURES_remove = "obmc-leds"
IMAGE_FEATURES_remove = "obmc-fan-control"
IMAGE_FEATURES_remove = "obmc-fan-mgmt"
IMAGE_FEATURES_remove = "obmc-flash-mgmt"
```
